## config/boards/shields/leeloo/Kconfig.defconfig
```kconfig
# Copyright (c) 2023 The ZMK Contributors
# SPDX-License-Identifier: MIT

if SHIELD_LEELOO_REV2_DONGLE

config ZMK_KEYBOARD_NAME
    default "Leeloo v2 dongle"

config ZMK_SPLIT_BLE_ROLE_CENTRAL
    default y

config ZMK_USB
    default y

endif

if SHIELD_LEELOO_REV2_LEFT || SHIELD_LEELOO_REV2_RIGHT || SHIELD_LEELOO_REV2_DONGLE

config ZMK_SPLIT
    default y

config ZMK_BLE
    default y

endif
```

## config/boards/shields/leelooo/Kconfig.defconfig
```kconfig
# Copyright (c) 2023 The ZMK Contributors
# SPDX-License-Identifier: MIT

if SHIELD_LEELOOO_DONGLE

config ZMK_KEYBOARD_NAME
    default "Leelooo dongle"

config ZMK_SPLIT_BLE_ROLE_CENTRAL
    default y

config ZMK_USB
    default y

endif

if SHIELD_LEELOOO_LEFT || SHIELD_LEELOOO_RIGHT || SHIELD_LEELOOO_DONGLE

config ZMK_SPLIT
    default y

config ZMK_BLE
    default y

endif
```

## config/boards/shields/leelooo/Kconfig.shield
```kconfig
# Copyright (c) 2023 The ZMK Contributors
# SPDX-License-Identifier: MIT

config SHIELD_LEELOOO
    bool

config SHIELD_LEELOOO_LEFT
    def_bool $(shields_list_contains,leelooo_left)
    select SHIELD_LEELOO

config SHIELD_LEELOOO_RIGHT
    def_bool $(shields_list_contains,leelooo_right)
    select SHIELD_LEELOO

config SHIELD_LEELOOO_DONGLE
    def_bool $(shields_list_contains,leelooo_dongle)
```

## config/boards/shields/ll/Kconfig.defconfig
```kconfig
# Copyright (c) 2023 The ZMK Contributors
# SPDX-License-Identifier: MIT

if SHIELD_LL_DONGLE
    config ZMK_KEYBOARD_NAME
        default "Leeloo v2"
    config ZMK_SPLIT_ROLE_CENTRAL
        default y
    config ZMK_USB
        default y
    config BT_MAX_CONN
        default 7
    config BT_MAX_PAIRED
        default 7
endif

if SHIELD_LL_LEFT || SHIELD_LL_RIGHT || SHIELD_LL_DONGLE

    config ZMK_SPLIT
        default y

    config ZMK_BLE
        default y

    if ZMK_DISPLAY
        config I2C
            default y
        config SSD1306
            default y
    endif # ZMK_DISPLAY

    if LVGL
        config LV_Z_VDB_SIZE
            default 64
        config LV_DPI_DEF
            default 148
        config LV_Z_BITS_PER_PIXEL
            default 1
        choice LV_COLOR_DEPTH
            default LV_COLOR_DEPTH_1
        endchoice
    endif # LVGL

endif
```

## config/boards/shields/ll/Kconfig.shield
```kconfig
# Copyright (c) 2023 The ZMK Contributors
# SPDX-License-Identifier: MIT

config SHIELD_LL_DONGLE
    def_bool $(shields_list_contains,ll_dongle)

config SHIELD_LL_LEFT
    def_bool $(shields_list_contains,ll_left)

config SHIELD_LL_RIGHT
    def_bool $(shields_list_contains,ll_right)
```

## config/west.yml
```yaml
manifest:
  remotes:
    - name: zmk
      url-base: https://github.com/zmkfirmware
    - name: zmkfix
      url-base: https://github.com/mstralenya
  projects:
    - name: zmk
      remote: zmk
      revision: main
      import: app/west.yml
  self:
    path: config
```
